// SPDX-License-Identifier: GPL-2.0-only OR MIT

#include "an7581-nokia_xg-040g-md-common.dtsi"
#include "an758x-nokia_xg-040g-ubi-parts.dtsi"

/ {
	model = "Nokia XG-040G-MD (UBI)";
	compatible = "nokia,xg-040g-md-ubi", "nokia,xg-040g-md", "airoha,an7581", "airoha,en7581";

	memory@80000000 {
		reg = <0x0 0x80000000 0x0 0x40000000>;
	};

	chosen {
		bootargs = "console=ttyS0,115200n8 earlycon ubi.block=0,fit root=/dev/fit0 rootwait rdinit=/sbin/init";
	};
};
